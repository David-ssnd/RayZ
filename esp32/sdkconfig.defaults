## esp32/sdkconfig.defaults
```kconfig
# Shared RayZ defaults applied to every environment
CONFIG_BT_ENABLED=y
CONFIG_BT_NIMBLE_ENABLED=y
CONFIG_BT_NIMBLE_MAX_CONNECTIONS=1

CONFIG_FREERTOS_HZ=1000
CONFIG_FREERTOS_USE_TRACE_FACILITY=y
CONFIG_FREERTOS_USE_STATS_FORMATTING_FUNCTIONS=y

CONFIG_COMPILER_CXX_EXCEPTIONS=y
CONFIG_COMPILER_CXX_RTTI=y

CONFIG_LOG_DEFAULT_LEVEL_INFO=y
CONFIG_LOG_MAXIMUM_LEVEL_VERBOSE=y
```

## esp32/target/sdkconfig.defaults
```kconfig
# Bluetooth configuration
# CONFIG_BT_ENABLED=y
# CONFIG_BT_NIMBLE_ENABLED=y
# CONFIG_BT_NIMBLE_ROLE_CENTRAL=y
# CONFIG_BT_NIMBLE_ROLE_OBSERVER=y
# CONFIG_BT_NIMBLE_MAX_CONNECTIONS=1

# FreeRTOS configuration
CONFIG_FREERTOS_HZ=1000
CONFIG_FREERTOS_USE_TRACE_FACILITY=y
CONFIG_FREERTOS_USE_STATS_FORMATTING_FUNCTIONS=y

# HTTP Server with WebSocket support
CONFIG_HTTPD_WS_SUPPORT=y

# ADC Configuration
CONFIG_ADC_ONESHOT_CTRL_FUNC_IN_IRAM=n

# Compiler options
CONFIG_COMPILER_CXX_EXCEPTIONS=y
CONFIG_COMPILER_CXX_RTTI=y

# ESP32 specific
CONFIG_ESP32_DEFAULT_CPU_FREQ_240=y

# Log level
CONFIG_LOG_DEFAULT_LEVEL_INFO=y
CONFIG_LOG_MAXIMUM_LEVEL_VERBOSE=y
```
